## configs/rpi5_defconfig
```kconfig
CONFIG_UK_ARCH="arm64"
CONFIG_PLAT_RPI5=y
CONFIG_LIBUKBOOT=y
CONFIG_LIBUKDEBUG=y
CONFIG_LIBUKALLOC=y
CONFIG_LIBNOLIBC=y
CONFIG_LIBFDT=y
CONFIG_LIBUKINTCTLR_GICV2=y
CONFIG_LIBUKBOOT_INITALLOC=y
CONFIG_LIBUKBOOT_BANNER_NONE=y
CONFIG_LIBUKPRINT_KLVL_INFO=y
CONFIG_OPTIMIZE_NONE=y
CONFIG_OPTIMIZE_SYMFILE=y
CONFIG_RPI5_EARLY_GDB_SPINLOOP=y
```
